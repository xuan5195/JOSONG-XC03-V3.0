
#include "stm32f10x_it.h"

/*
*********************************************************************************************************
*	Cortex-M3 内核异常中断服务程序
*********************************************************************************************************
*/

/*
*********************************************************************************************************
*	函 数 名: NMI_Handler
*	功能说明: 不可屏蔽中断服务程序。
*	形    参：无
*	返 回 值: 无
*********************************************************************************************************
*/  
void NMI_Handler(void)
{
}

/*
*********************************************************************************************************
*	函 数 名: HardFault_Handler
*	功能说明: 硬件失效中断服务程序。
*	形    参：无
*	返 回 值: 无
*********************************************************************************************************
*/ 
void HardFault_Handler(void)
{
  /* 当硬件失效异常发生时进入死循环 */
  while (1)
  {
  }
}

/*
*********************************************************************************************************
*	函 数 名: MemManage_Handler
*	功能说明: 内存管理异常中断服务程序。
*	形    参：无
*	返 回 值: 无
*********************************************************************************************************
*/   
void MemManage_Handler(void)
{
  /* 当内存管理异常发生时进入死循环 */
  while (1)
  {
  }
}

/*
*********************************************************************************************************
*	函 数 名: BusFault_Handler
*	功能说明: 总线访问异常中断服务程序。
*	形    参：无
*	返 回 值: 无
*********************************************************************************************************
*/    
void BusFault_Handler(void)
{
  /* 当总线异常时进入死循环 */
  while (1)
  {
  }
}

/*
*********************************************************************************************************
*	函 数 名: UsageFault_Handler
*	功能说明: 未定义的指令或非法状态中断服务程序。
*	形    参：无
*	返 回 值: 无
*********************************************************************************************************
*/   
void UsageFault_Handler(void)
{
  /* 当用法异常时进入死循环 */
  while (1)
  {
  }
}

/*
*********************************************************************************************************
*	函 数 名: SVC_Handler
*	功能说明: 通过SWI指令的系统服务调用中断服务程序。
*	形    参：无
*	返 回 值: 无
*********************************************************************************************************
*/   
void SVC_Handler(void)
{
}

/*
*********************************************************************************************************
*	函 数 名: DebugMon_Handler
*	功能说明: 调试监视器中断服务程序。
*	形    参：无
*	返 回 值: 无
*********************************************************************************************************
*/   
void DebugMon_Handler(void)
{
}

/*
*********************************************************************************************************
*	函 数 名: PendSV_Handler
*	功能说明: 可挂起的系统服务调用中断服务程序。
*	形    参：无
*	返 回 值: 无
*********************************************************************************************************
*/     
void PendSV_Handler(void)
{
}

/*
*********************************************************************************************************
*	函 数 名: SysTick_Handler
*	功能说明: 系统嘀嗒定时器中断服务程序。
*	形    参：无
*	返 回 值: 无
*********************************************************************************************************
*/     
extern void SysTick_ISR(void);	/* 声明调用外部的函数 */
void SysTick_Handler(void)
{
	SysTick_ISR();	/* 这个函数在bsp_timer.c中 */
}

u8  TIM2CH1_CAPTURE_STA=0;	//输入捕获状态		    				
u16	TIM2CH1_CAPTURE_VAL;	//输入捕获值
extern uint8_t InPutCount;	//输入脉冲计数
extern uint8_t OutFlag; 	//输出标志

//定时器2中断服务程序	 
void TIM2_IRQHandler(void)
{ 
 	if((TIM2CH1_CAPTURE_STA&0x80)==0)//还未成功捕获	
	{	  
		if (TIM_GetITStatus(TIM2, TIM_IT_Update) != RESET)	//更新中断		 
		{	    
			if(TIM2CH1_CAPTURE_STA&0x40)//已经捕获到高电平了
			{
				if((TIM2CH1_CAPTURE_STA&0x3F)==0x3F)//低电平太长，清标志
				{
					TIM2CH1_CAPTURE_STA = 0x00;	//清标志，等待下一次
					TIM2CH1_CAPTURE_VAL = 0x00;
				}
				else TIM2CH1_CAPTURE_STA++;	//更新中断计数累加
			}	 
		}
		if (TIM_GetITStatus(TIM2, TIM_IT_CC1) != RESET)//捕获1发生捕获事件
		{	
			if((TIM2CH1_CAPTURE_STA&0x40)==0x40)		//捕获到上升沿		
			{	  			
				TIM2CH1_CAPTURE_STA|=0x80;		//标记成功捕获到一次低电平脉宽
				TIM2CH1_CAPTURE_VAL=TIM_GetCapture1(TIM2);	//取出捕获值
		   		TIM_OC1PolarityConfig(TIM2,TIM_ICPolarity_Falling);		//CC1P=1 设置为下降沿捕获
				//printf("low:%d us\r\n",TIM2CH1_CAPTURE_VAL);//打印总的低电平时间
				if((TIM2CH1_CAPTURE_VAL>38)&&(TIM2CH1_CAPTURE_VAL<62)&&(TIM2CH1_CAPTURE_STA==0xC0))	//脉冲宽度
				{	//脉冲宽度为42-58uS
					if(OutFlag==0xAA)	{	InPutCount++;		}	//放水标志
					else				{	InPutCount = 0;		}	//清计数
				}
				TIM2CH1_CAPTURE_STA=0x00;		//清准备下一次进入
			}
			else  								//捕获下降沿
			{
				TIM2CH1_CAPTURE_VAL = 0;		//清空
				TIM2CH1_CAPTURE_STA = 0x40;		//标记捕获到了下降沿，并清更新中断计数(低6位)
	 			TIM_SetCounter(TIM2,0);			//清计数值
		   		TIM_OC1PolarityConfig(TIM2,TIM_ICPolarity_Rising); //CC1P=0 设置为上升沿捕获
			}		    
		}			     	    					   
 	}
 
    TIM_ClearITPendingBit(TIM2, TIM_IT_CC1|TIM_IT_Update); //清除中断标志位
 
}


/*
*********************************************************************************************************
*	STM32F10x内部外设中断服务程序
*	用户在此添加用到外设中断服务函数。有效的中断服务函数名请参考启动文件(startup_stm32f10x_xx.s)
*********************************************************************************************************
*/

/*
*********************************************************************************************************
*	函 数 名: PPP_IRQHandler
*	功能说明: 外设中断服务程序。
*	形    参：无
*	返 回 值: 无
*********************************************************************************************************
*/    
/* 
	因为中断服务程序往往和具体的应用有关，会用到用户功能模块的变量、函数。如果在本文件展开，会增加大量的
	外部变量声明或者include语句。
	
	因此，我们推荐这个地方只写一个调用语句，中断服务函数的本体放到对应的用户功能模块中。
	增加一层调用会降低代码的执行效率，不过我们宁愿损失这个效率，从而增强程序的模块化特性。
	
	增加extern关键字，直接引用用到的外部函数，避免在文件头include其他模块的头文件
extern void ppp_ISR(void);	
void PPP_IRQHandler(void)
{
	ppp_ISR();
}
*/
