#include "stm32f10x.h"
#include <stdio.h>

#include "bsp.h"
#include "bsp_fifo.h"

CQ_FIFO_T s_gCQ;		//消息FIFO变量,结构体 */
static CQ_FIFO_T s_tCQ;		//消息FIFO变量,结构体 */
/*
*********************************************************************************************************
*	函 数 名: bsp_InitCQVar
*	功能说明: 初始化按键变量
*	形    参:  无
*	返 回 值: 无
*********************************************************************************************************
*/
void bsp_InitCQVar(void)
{
	s_tCQ.Read  = 0;
	s_tCQ.Write = 0;
	s_tCQ.Read2 = 0;
	s_gCQ.Read  = 0;
	s_gCQ.Write = 0;
	s_gCQ.Read2 = 0;
}
/*
*********************************************************************************************************
*	函 数 名: bsp_PutCQ
*	功能说明: 将值压入按键FIFO缓冲区。
*	形    参:  _KeyCode : 按键代码
*	返 回 值: 无
*********************************************************************************************************
*/
void bsp_PutCQ(uint8_t *_Date)
{
	memcpy(s_tCQ.Buf[s_tCQ.Write],_Date,16);

	if (++s_tCQ.Write  >= CQ_FIFO_SIZE)
	{
		s_tCQ.Write = 0;
	}
}

/*
*********************************************************************************************************
*	函 数 名: bsp_GetCQ
*	功能说明: 从FIFO缓冲区读取一个值。
*	形    参:  无
*	返 回 值: 
*********************************************************************************************************
*/
uint8_t bsp_GetCQ(uint8_t *_Date)
{
	if (s_tCQ.Read == s_tCQ.Write)
	{
		return CQ_NONE;
	}
	else
	{
		memcpy(_Date,s_tCQ.Buf[s_tCQ.Read],16);
		if (++s_tCQ.Read >= CQ_FIFO_SIZE)
		{
			s_tCQ.Read = 0;
		}
		return CQ_OK;
	}
}

/*
*********************************************************************************************************
*	函 数 名: bsp_GetCQ2
*	功能说明: 从FIFO缓冲区读取一个值。
*	形    参:  无
*	返 回 值: 
*********************************************************************************************************
*/
uint8_t bsp_GetCQ2(uint8_t *_Date)
{
	if (s_tCQ.Read2 == s_tCQ.Write)
	{
		return CQ_NONE;
	}
	else
	{
		memcpy(_Date,s_tCQ.Buf[s_tCQ.Read2],16);
		if (++s_tCQ.Read2 >= CQ_FIFO_SIZE)
		{
			s_tCQ.Read2 = 0;
		}
		return CQ_OK;
	}
}

